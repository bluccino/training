## CMakeLists.txt
```
# SPDX-License-Identifier: Apache-2.0

  cmake_minimum_required(VERSION 3.20.0)
  find_package(Zephyr REQUIRED HINTS $ENV{ZEPHYR_BASE})

#===============================================================================
# project definition and path setup
#===============================================================================

  project(02-logging)

  set (LIB ../../lib/V0.5)
  set (BLU ${LIB}/bluccino)
  set (SRC src)

  include_directories(${SRC} ${BLU})

#===============================================================================
# source files
#===============================================================================

  target_sources(app PRIVATE
                 ${SRC}/main.c
                 ${BLU}/bluccino.c
                )
```

## prj.conf
```kconfig
# 1024 byte stack is the minimum requirement for most of the samples
CONFIG_MAIN_STACK_SIZE=1024

# for Segger RTT we need the following config's
CONFIG_USE_SEGGER_RTT=y
CONFIG_RTT_CONSOLE=y
CONFIG_UART_CONSOLE=n
CONFIG_LOG_BUFFER_SIZE=4096
```

## src/main.c
```c
//==============================================================================
// main.c for 02-logging demo
//==============================================================================

#include "bluccino.h"

#define LOG  LOG_TEST  // use LOG as a shorthand for predefined macro LOG_TEST

//==============================================================================
// log() function - does 4 loggings at different log levels and log colors
//==============================================================================

  static void log(void)
  {
    char *msg = "is a prime number";
    int n = 17;

    LOG(1,BL_M "number %d %s",n,msg);  // no comma between BL_M and "number ..."
    LOG(2,BL_G "number %d %s",n,msg);  // no comma between BL_G and "number ..."
    LOG(3,BL_B "number %d %s",n,msg);  // no comma between BL_B and "number ..."
    LOG(4,BL_Y "number %d %s",n,msg);  // no comma between BL_Y and "number ..."
  }

//==============================================================================
// our main program
//==============================================================================

  void main(void)
  {
    bl_hello(4,"02-logging (verbose level 4)");
    log();

    bl_hello(3,"02-logging (verbose level 3)");
    log();

    bl_hello(2,"02-logging (verbose level 2)");
    log();

    bl_hello(1,"02-logging (verbose level 1)");
    log();

    bl_hello(0,"02-logging (verbose level 0)");
    log();
  }
```
