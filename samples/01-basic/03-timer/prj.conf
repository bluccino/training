## CMakeLists.txt
```
# SPDX-License-Identifier: Apache-2.0

  cmake_minimum_required(VERSION 3.20.0)
  set(QEMU_EXTRA_FLAGS -s)
  find_package(Zephyr REQUIRED HINTS $ENV{ZEPHYR_BASE})

#===============================================================================
# project definition and path setup
#===============================================================================

  project(04-sos)

  set (LIB ../../lib/V0.2)
  set (BLU ${LIB}/bluccino)
  set (SRC src)

  include_directories(${SRC} ${BLU})

  add_definitions(-DCFG_PRETTY_LOGGING=1)   # push define down to C level
# add_definitions(-DBL_CONFIG="config.h")   # push define down to C level
# add_definitions(-DBL_LOGGING="logging.h") # push define down to C level

#===============================================================================
# source files
#===============================================================================

  target_sources(app PRIVATE
               ${SRC}/main.c
               ${SRC}/timer.c
               ${BLU}/blapi.c
               ${BLU}/bllog.c
              )
```

## prj.conf
```kconfig
#CONFIG_INIT_STACKS=y      # if set, lots of noise from mesh/adv.c: STACK_ANALYZE
CONFIG_MAIN_STACK_SIZE=1024
CONFIG_SYSTEM_WORKQUEUE_STACK_SIZE=2048

CONFIG_GPIO=y

CONFIG_BT_SETTINGS=y
CONFIG_FLASH=y
CONFIG_FLASH_PAGE_LAYOUT=y
CONFIG_FLASH_MAP=y
CONFIG_NVS=y
CONFIG_SETTINGS=y
CONFIG_BT_MESH_RPL_STORE_TIMEOUT=600

CONFIG_BOOT_BANNER=y

CONFIG_BT_OBSERVER=y
CONFIG_BT_BROADCASTER=y
CONFIG_BT_CTLR_DUP_FILTER_LEN=0
CONFIG_BT_CTLR_LE_ENC=n
CONFIG_BT_CTLR_LE_PING=n
CONFIG_BT_DATA_LEN_UPDATE=n
CONFIG_BT_PHY_UPDATE=n
CONFIG_BT_CTLR_CHAN_SEL_2=n
CONFIG_BT_CTLR_MIN_USED_CHAN=n
CONFIG_BT_CTLR_ADV_EXT=n
CONFIG_BT_CTLR_PRIVACY=n

CONFIG_BT_PERIPHERAL=y

CONFIG_BT=y
CONFIG_BT_TINYCRYPT_ECC=y
CONFIG_BT_L2CAP_TX_BUF_COUNT=8

CONFIG_BT_MESH=y
CONFIG_BT_MESH_RELAY=y
CONFIG_BT_MESH_RELAY_ENABLED=n
CONFIG_BT_MESH_BEACON_ENABLED=n
CONFIG_BT_MESH_LOW_POWER=n
CONFIG_BT_MESH_FRIEND=n
CONFIG_BT_MESH_FRIEND_QUEUE_SIZE=16
CONFIG_BT_MESH_ADV_BUF_COUNT=20
CONFIG_BT_MESH_TX_SEG_MAX=6

CONFIG_BT_MESH_PB_GATT=y
CONFIG_BT_MESH_PB_ADV=y
CONFIG_BT_MESH_GATT_PROXY=y
CONFIG_BT_MESH_CFG_CLI=y

#CONFIG_BT_MESH_LPN_SCAN_LATENCY=30
#CONFIG_BT_MESH_LPN_RECV_DELAY=40
#CONFIG_BT_MESH_LPN_POLL_TIMEOUT=300

CONFIG_BT_MESH_SUBNET_COUNT=2
CONFIG_BT_MESH_APP_KEY_COUNT=2
CONFIG_BT_MESH_MODEL_KEY_COUNT=2
CONFIG_BT_MESH_MODEL_GROUP_COUNT=2
CONFIG_BT_MESH_LABEL_COUNT=3

#CONFIG_BT_MESH_IV_UPDATE_TEST=y

CONFIG_UART_CONSOLE=y

# this outputs btmon formatted data to the serial port
#CONFIG_BT_DEBUG_MONITOR_UART=y

CONFIG_BT_DEBUG_LOG=y

CONFIG_BT_MESH_DEBUG=y
#CONFIG_BT_MESH_DEBUG_PROV=y
#CONFIG_BT_MESH_DEBUG_PROXY=y
#CONFIG_BT_MESH_DEBUG_BEACON=y
#CONFIG_BT_MESH_DEBUG_NET=y
#CONFIG_BT_MESH_DEBUG_TRANS=y
#CONFIG_BT_MESH_DEBUG_LOW_POWER=y
#CONFIG_BT_MESH_DEBUG_FRIEND=y
#CONFIG_BT_MESH_DEBUG_MODEL=y
#CONFIG_BT_MESH_DEBUG_ACCESS=y
#CONFIG_BT_MESH_DEBUG_CRYPTO=y
#CONFIG_BT_MESH_DEBUG_ADV=y
#CONFIG_BT_MESH_SELF_TEST=y

#CONFIG_BT_HCI_VS_EXT=n

#CONFIG_STACK_USAGE=y

CONFIG_BT_RX_STACK_SIZE=4096

#CONFIG_BT_DEBUG_HCI_DRIVER=y
#CONFIG_BT_DEBUG_HCI_CORE=y
#CONFIG_BT_DEBUG_GATT=y
#CONFIG_BT_DEBUG_CONN=y

CONFIG_BT_MAX_CONN=1
CONFIG_BT_CTLR_RX_BUFFERS=6
CONFIG_BT_BUF_ACL_TX_COUNT=4
CONFIG_BT_BUF_CMD_TX_COUNT=4

CONFIG_BT_ATT_PREPARE_COUNT=2

#CONFIG_NET_BUF_SIMPLE_LOG=y
#CONFIG_NET_BUF_LOG=y
#CONFIG_BT_CTLR_DEBUG_PINS=y

# iHux: added for Segger RTT
CONFIG_USE_SEGGER_RTT=y
CONFIG_RTT_CONSOLE=y
CONFIG_UART_CONSOLE=n
```

## src/main.c
```c
//==============================================================================
// main.c for 02-timer demo
//==============================================================================

#include "bluccino.h"
#include "timer.h"

//==============================================================================
// when callback
//==============================================================================

  int when(BL_ob *o, int val)
  {
    switch (o->op)
    {
      case OP_TICK:
        bl_logo(1,BL_G"when",o,val);
        return 0;
      default:
        return -1;
    }
  }

//==============================================================================
// mandatory init/loop functions for app
//==============================================================================

  static void init(void)
  {
  }

  static void loop(void)               // app loop
  {
     bl_sleep(10);                     // sleep 10 ms
  }

//==============================================================================
// framework engine
//==============================================================================

  void main(void)
  {
    bl_verbose(2);                     // set verbose mode
    bl_init(NULL,NULL);                // Bluccino init (no callback passing)
    bl_init(timer,when);               // TIMER init (pass 'when' callback)
    init();                            // app init

    for(;;)
    {
      bl_loop(NULL);                   // run Bluccino loop
      bl_loop(timer);                  // run TIMER loop
      loop();                          // run app loop
    }
  }
```

## src/timer.c
```c
//==============================================================================
// timer.c - a simple timer module
//==============================================================================

#include "bluccino.h"
#include "timer.h"

  static BL_fct notify = NULL;
  static BL_ms time = 0;

    // timer messaging object

  static BL_ob tim = {CL_TIMER,OP_TICK,0,NULL};

//==============================================================================
// public interface
//==============================================================================

  int timer(BL_ob *o, int val)
  {
    switch (o->op)
    {
      case OP_INIT:
        bl_logo(1,BL_B"timer",o,val);
        notify = o->data;
        return 0;

      case OP_LOOP:
        if (bl_ms() >= time)
        {
          bl_logo(3,"loop",&tim,time);
          bl_out(&tim,time,notify);        // emit tick message
          time += 1000;                    // next time = current time + 1000 ms
        }
        return 0;

      default:
        return 0;
    }
  }
```

## src/timer.h
```c
//==============================================================================
// timer.h - a simple timer module
//==============================================================================
//
//  Interfaces: [TICK] = TIMER(TRIG)
//
//  Input Messages:
//    - [TIMER:TRIG]    main loop driving timer modules with trigger messages
//
//  Output Messages:
//    - [TIMER:TICK]    timer module outputs tick messages
//
//                               [:TRIG] [:TICK]
//                                  |      ^
//                                  v      |
//                               +-------------+
//                               |             |
//                               |    TIMER    |
//                               |             |
//                               +-------------+
//
//==============================================================================

#ifndef __TIMER_H__
#define __TIMER_H__

  int  timer(BL_ob *o, int value);     // TIMER interface

#endif // __TIMER_H__
```
