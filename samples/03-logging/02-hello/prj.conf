## CMakeLists.txt
```
# SPDX-License-Identifier: Apache-2.0

  cmake_minimum_required(VERSION 3.20.0)
  find_package(Zephyr REQUIRED HINTS $ENV{ZEPHYR_BASE})

#===============================================================================
# project personality (definitions to be pushed down to C-level)
#===============================================================================

  project(02-hello)

    # use Bluccino Real Time Logging (RTL) with 1k log buffer

  add_definitions(-DCFG_BLUCCINO_RTL=1024)   # Bluccino RTL, 1k log buffer

#===============================================================================
# path setup
#===============================================================================

  set (LIB ../../../lib/V1.0.8)
  set (BLU ${LIB}/bluccino)
  set (SRC src)

  include_directories(${BLU})

#===============================================================================
# source files
#===============================================================================

  target_sources(app PRIVATE ${SRC}/main.c
                 ${BLU}/bl_time.c
                 ${BLU}/bl_log.c
                 ${BLU}/bl_deco.c
                 ${BLU}/bl_gear.c
                 ${BLU}/bl_run.c
                 ${BLU}/bl_core.c
                )
```

## prj.conf
```kconfig
# this app goes well with 512 byte stack (usually we should have >1024 bytes)
CONFIG_MAIN_STACK_SIZE=512

# for Segger RTT we need the following config's
CONFIG_USE_SEGGER_RTT=y
CONFIG_RTT_CONSOLE=y
#CONFIG_UART_CONSOLE=n

CONFIG_USB_DEVICE_STACK=y
CONFIG_USB_DEVICE_PRODUCT="Zephyr USB console sample"

CONFIG_SERIAL=y
CONFIG_CONSOLE=y
CONFIG_UART_CONSOLE=y
CONFIG_UART_LINE_CTRL=y
```

## src/main.c
```c
//==============================================================================
// main.c for 01-hello demo (hello world)
//==============================================================================

  #include "bluccino.h"                // access Bluccino stuff

  void main(void)                      // main() for 01-hello demo (hello world)
  {
    bl_rtl_init();
//    bl_prt("hello, world!\n");
    BL_LOG(1,"hello, world!");
  }
```

## src/bl_lfifo.c
```c
//==============================================================================
// fc_lfifo.c
// FIFO for real time logging
//
// Created by Chintan Parmar on 2022-July-04
// Copyright © 2022 fuseAware. All rights reserved.
//==============================================================================

  #include <string.h>

  #include "bluccino.h"
  #include "bl_rtl.h"
  #include "bl_lfifo.h"

//==============================================================================
// CORE level logging shorthands
//==============================================================================

  #define LOG                     LOG_CORE
  #define LOGO(lvl,col,o,val)     LOGO_CORE(lvl,col"fc_lfifo:",o,val)
  #define LOG0(lvl,col,o,val)     LOGO_CORE(lvl,col,o,val)

//==============================================================================
// log fifo
//==============================================================================

  #define NLFIFO 50                              // number of logs in fifo

  typedef struct FA_lfifo                        // log fifo
          {
            BL_rtl fifo[NLFIFO];                 // to store log data
            uint8_t len;                         // fifo length
            uint8_t gdx;                         // get index
            uint8_t pdx;                         // put index
            volatile uint8_t free;               // number of free fifo items
          } FA_lfifo;                            // log fifo

    // THE log fifo

  static FA_lfifo lfifo = { len: NLFIFO, gdx:0, pdx:0, free: NLFIFO };
  static int drops = 0;                         // drop counter for log messages

//==============================================================================
// get FA_rtl data from log fifo
// - usage: err = fc_lfifo_get(p)      // return 0:OK, -1:error
//==============================================================================

  int fc_lfifo_get(BL_rtl *p)
  {
//    if (fl_dbg(6))
//      bl_prt(BL_C"lfifo: get(%d)\n",lfifo.len-lfifo.free);

    if (lfifo.free == lfifo.len)
      return -1;                            // no more log data in fifo

    BL_rtl *q = lfifo.fifo + lfifo.gdx;
    lfifo.gdx = (lfifo.gdx + 1) % lfifo.len;// cyclic increment of get index

    memcpy(p,q,sizeof(BL_rtl));             // copy log data from fifo
    lfifo.free++;                           // another one fifo cell went free
    return 0;                               // OK
  }

//==============================================================================
// put FA_rtl data to log fifo
// - usage: err = fc_lfifo_put(p)      // return 0:OK, -1:error
//==============================================================================

  int fc_lfifo_put(BL_rtl *p)
  {
//    if (fl_dbg(6))
//      bl_prt(BL_C"lfifo: put(%d)\n",lfifo.len-lfifo.free+1);

    if (lfifo.free == 0)
      return -1;                            // log fifo full

    BL_rtl *q = lfifo.fifo + lfifo.pdx;     // pointer to free fifo cell
    lfifo.pdx = (lfifo.pdx + 1) % NLFIFO;   // cyclic increment of put index

    memcpy(q,p,sizeof(BL_rtl));             // copy log data into fifo
    lfifo.free--;
    return 0;
  }

//==============================================================================
// how many <FA_rtl> data entries are in fifo?
// - usage: n = fc_lfifo_avail()            // return number of available
//==============================================================================

  int fc_lfifo_avail(void)
  {
    return (lfifo.len - lfifo.free);
  }

//==============================================================================
// is fifo full?
// - usage: full = fc_lfifo_full()            // return true if fifo is full
//==============================================================================

  bool fc_lfifo_full(void)
  {
    return (lfifo.free == 0);
  }

//==============================================================================
// increase the log drop counter
// - usage: drops = fc_lfifo_drop(0)     // read number of drops and clear drops
//          fc_lfifo_drop(1)             // increment drops counter
//==============================================================================

  int fc_lfifo_drop(int mode)
  {
    if(!mode)                           // read number of drops and clear drops
    {
      int drop_cnt = drops;
      drops = 0;
      return drop_cnt;
    }
    else                                // increment drops counter
    {
        drops++;
        return drops;
    }
  }
```

## src/bl_lfifo.h
```c
//==============================================================================
// fc_lfifo.h
// FIFO for logs
//
// Created by Chintan Parmar on 2022-July-05
// Copyright © 2022 fuseAware. All rights reserved.
//==============================================================================
//

#ifndef __FC_LFIFO_H__
#define __FC_LFIFO_H__

//==============================================================================
// get BL_rtl data from log fifo
// - usage: err = fc_bfifo_get(p)      // return 0:OK, -1:error
//==============================================================================

  int fc_lfifo_get(BL_rtl *p);

//==============================================================================
// put BL_rtl data to log fifo
// - usage: err = fc_bfifo_put(p)      // return 0:OK, -1:error
//==============================================================================

  int fc_lfifo_put(BL_rtl *p);

//==============================================================================
// how many <BL_rtl> data entries are in fifo?
// - usage: n = fc_bfifo_avail()            // return number of available
//==============================================================================

  int fc_lfifo_avail(void);            // return number of available <BL_rtl>

//==============================================================================
// is fifo full?
// - usage: full = fc_lfifo_full()            // return true if fifo is full
//==============================================================================

  bool fc_lfifo_full(void);

//==============================================================================
// increase the log drop counter
// - usage: drops = fc_lfifo_drop(0)     // read number of drops and clear drops
//          fc_lfifo_drop(1)             // increment drops counter
//==============================================================================

  int fc_lfifo_drop(int mode);

#endif // __FC_LFIFO_H__
```
