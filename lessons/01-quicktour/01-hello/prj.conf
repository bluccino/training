## CMakeLists.txt
```
# SPDX-License-Identifier: Apache-2.0

  cmake_minimum_required(VERSION 3.20.0)
  find_package(Zephyr REQUIRED HINTS $ENV{ZEPHYR_BASE})

#===============================================================================
# project definition and path setup
#===============================================================================

  project(01-hello)

  set (LIB ../../../lib/V1.0.6)
  set (BLU ${LIB}/bluccino)
  set (SRC src)

  include_directories(${SRC} ${BLU})

#===============================================================================
# source files
#===============================================================================

  target_sources(app PRIVATE ${SRC}/main.c ${BLU}/bluccino.c)
```

## prj.conf
```kconfig
# this app goes well with 512 byte stack (usually we should have >1024 bytes)
CONFIG_MAIN_STACK_SIZE=512

# for Segger RTT we need the following config's
CONFIG_USE_SEGGER_RTT=y
CONFIG_RTT_CONSOLE=y
CONFIG_UART_CONSOLE=n
```

## src/main.c
```c
//==============================================================================
// main.c for 01-hello demo (hello world)
//==============================================================================

#include "bluccino.h"

  void main(void)                      // main() for 01-hello demo (hello world)
  {
    bl_prt("hello, world!\n");
  }
```
